## drivers/misc/samsung/scsc_bt/Kconfig
```kconfig
config SCSC_BT
        tristate "SCSC MX BT support"
        depends on SCSC_CORE

config SCSC_BT_BLUEZ
	default N
        tristate "SCSC MX BlueZ support"
        depends on SCSC_CORE
	depends on BT
	---help---
	  Lets the Linux Bluetooth stack (BlueZ) use the built-in Bluetooth
	  chip as an HCI device, for tools such as hciconfig, hcitool and
	  btmon. Nothing happens until it is switched on by hand:

	    echo 1 > /sys/module/scsc_bt/parameters/power_control

	  The chip has one user at a time: Android Bluetooth must be off
	  while the HCI device is up, and the other way round.

config SCSC_ANT
	default Y
        tristate "SCSC MX ANT support"
        depends on SCSC_CORE
	---help---
	  This module adds support for using a ANT character device.

config SCSC_BT_ADDRESS_IN_FILE
	default N
	tristate "SCSC MX BT support"
	depends on SCSC_CORE
	---help---
	  Allow BT address to be read from a file

config SCSC_BT_ADDRESS_FILENAME
	string "BT address filename"
	depends on SCSC_CORE
	default "/mnt/vendor/efs/bluetooth/bt_addr"
	---help---
	  Select the named BT address override file.
```

## drivers/net/wireless/realtek/rtl8812au/Kconfig
```kconfig
config 88XXAU
	tristate "Realtek RTL8812AU/RTL8821AU/RTL8814AU USB WiFi (aircrack-ng driver)"
	depends on USB && CFG80211
	select WIRELESS_EXT
	select WEXT_PRIV
	help
	  Out-of-tree driver from https://github.com/aircrack-ng/rtl8812au
	  (branch v5.6.4.2) for Realtek 802.11ac USB adapters. It supports
	  monitor mode and frame injection.
```

## drivers/net/wireless/realtek/rtl88x2bu/Kconfig
```kconfig
config RTL8822BU
	tristate "Realtek RTL8812BU/RTL8822BU USB WiFi (RinCat vendor driver)"
	depends on USB && CFG80211
	select WIRELESS_EXT
	select WEXT_PRIV
	help
	  Out-of-tree driver from
	  https://github.com/RinCat/RTL88x2BU-Linux-Driver (master) for Realtek
	  RTL8812BU / RTL8822BU 802.11ac USB adapters. It supports monitor mode
	  and frame injection.
```
